## config/boards/shields/keyball44/Kconfig.defconfig
```kconfig
# Copyright (c) 2022 The ZMK Contributors
# SPDX-License-Identifier: MIT

if SHIELD_KEYBALL44_RIGHT

config ZMK_KEYBOARD_NAME
    default "KEYBALL44"
    
config ZMK_SPLIT_ROLE_CENTRAL
    default y
endif

if SHIELD_KEYBALL44_LEFT    
config ZMK_SPLIT_ROLE_CENTRAL
    default n

endif

if SHIELD_KEYBALL44_LEFT || SHIELD_KEYBALL44_RIGHT
config ZMK_SPLIT
    default y

if ZMK_DISPLAY

choice SSD1306_CONTROLLER_TYPE
	default SSD1306_SH1106_COMPATIBLE if SHIELD_SH1106_128X64
endchoice

if LVGL

config LV_Z_VDB_SIZE
	default 64

config LV_Z_DPI
	default 116 if SHIELD_SH1106_128X64
	default 148

config LV_Z_BITS_PER_PIXEL
	default 1

choice LV_COLOR_DEPTH
	default LV_COLOR_DEPTH_1
endchoice

endif # LVGL

endif # DISPLAY

    
endif
```
